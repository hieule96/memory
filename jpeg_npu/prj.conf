## CMakeLists.txt
```
# SPDX-License-Identifier: Apache-2.0

cmake_minimum_required(VERSION 3.20.0)
find_package(Zephyr REQUIRED HINTS $ENV{ZEPHYR_BASE})
project(jpeg_npu)

target_sources(app PRIVATE
	src/main.c
	src/preprocess.c
	src/inference.cpp
)

# int8 TFLite model to deploy. Without one, the MLPerf Tiny Visual Wake Words
# reference model (MobileNetV1 0.25, 96x96 RGB, person / no person) is fetched.
set(MODEL_TFLITE "" CACHE FILEPATH "int8 TFLite model to deploy")
if(NOT MODEL_TFLITE)
	set(MODEL_TFLITE ${CMAKE_BINARY_DIR}/model/vww_96_int8.tflite)
	if(NOT EXISTS ${MODEL_TFLITE})
		file(DOWNLOAD
			https://raw.githubusercontent.com/mlcommons/tiny/master/benchmark/training/visual_wake_words/trained_models/vww_96_int8.tflite
			${MODEL_TFLITE}
			EXPECTED_HASH SHA256=597a384c8c2c8a1276f04702f25013b7838f2f814f1ca7c174d295b73e3d6b7b
			STATUS download_status
		)
		list(GET download_status 0 download_error)
		if(NOT download_error EQUAL 0)
			file(REMOVE ${MODEL_TFLITE})
			message(FATAL_ERROR "Downloading the default model failed: ${download_status}. "
				"Pass an int8 TFLite model with -DMODEL_TFLITE=<file>.")
		endif()
	endif()
endif()

if(CONFIG_TFLM_NXP_NEUTRON)
	# The compiler and the runtime libraries come from the same eIQ Neutron SDK:
	# the driver refuses microcode produced by a different compiler version.
	set(NEUTRON_SDK_DIR "$ENV{NEUTRON_SDK_DIR}" CACHE PATH "eIQ Neutron SDK directory")
	set(neutron_compiler ${NEUTRON_SDK_DIR}/bin/neutron-compiler)
	set(neutron_lib_dir ${NEUTRON_SDK_DIR}/target/imxrt700/rt700/cm33)

	if(NOT EXISTS ${neutron_compiler} OR NOT EXISTS ${neutron_lib_dir}/libNeutronDriver.a)
		message(FATAL_ERROR "eIQ Neutron SDK not found in '${NEUTRON_SDK_DIR}'. "
			"Pass it with -DNEUTRON_SDK_DIR=<dir> or the NEUTRON_SDK_DIR environment variable.")
	endif()

	set_target_properties(neutron_driver PROPERTIES
		IMPORTED_LOCATION ${neutron_lib_dir}/libNeutronDriver.a)
	set_target_properties(neutron_firmware PROPERTIES
		IMPORTED_LOCATION ${neutron_lib_dir}/libNeutronFirmware.a)

	# Sequencer mode is faster but needs the model in SRAM, where the
	# application keeps it anyway: the NPU cannot read the flash.
	set(model_bin ${CMAKE_BINARY_DIR}/model/model_npu.tflite)
	add_custom_command(
		OUTPUT ${model_bin}
		COMMAND ${neutron_compiler}
			--input ${MODEL_TFLITE}
			--output ${model_bin}
			--target imxrt700
			--use-sequencer
			--dump-statistics
		DEPENDS ${MODEL_TFLITE}
		WORKING_DIRECTORY ${CMAKE_BINARY_DIR}/model
		COMMENT "Compiling ${MODEL_TFLITE} for the Neutron NPU"
	)
else()
	set(model_bin ${MODEL_TFLITE})
endif()

generate_inc_file_for_target(app ${model_bin} ${ZEPHYR_BINARY_DIR}/include/generated/model.inc)

# Optional MJPEG file embedded in the image and written to the volume when the
# input file is missing, for boards without a prepared SD card.
set(TEST_MJPEG "" CACHE FILEPATH "MJPEG file to embed as test input")
if(TEST_MJPEG)
	generate_inc_file_for_target(app ${TEST_MJPEG}
		${ZEPHYR_BINARY_DIR}/include/generated/mjpeg.inc)
	target_compile_definitions(app PRIVATE EMBED_TEST_MJPEG)
endif()
```

## Kconfig
```
# Copyright 2026 NXP
# SPDX-License-Identifier: Apache-2.0

mainmenu "MJPEG decode and NPU inference pipeline"

menu "Pipeline configuration"

config FILE_INPUT_PATH
	string "Input MJPEG file path"
	default "/SD:/input.mjpeg"
	help
	  Absolute path to the MJPEG input file: concatenated JPEG frames, all
	  of the size set by JPEG_IMAGE_WIDTH and JPEG_IMAGE_HEIGHT.

config JPEG_IMAGE_WIDTH
	int "Width of the JPEG frames"
	default 576

config JPEG_IMAGE_HEIGHT
	int "Height of the JPEG frames"
	default 432

endmenu

menu "Inference configuration"

config MODEL_LABELS
	string "Comma-separated class labels"
	default "no person,person"
	help
	  One label per model output, in output order. The default matches the
	  MLPerf Tiny Visual Wake Words model.

config TENSOR_ARENA_SIZE
	int "TFLM tensor arena size in bytes"
	default 131072
	help
	  Holds the model's input, output, intermediate tensors and the NPU
	  scratch buffer. The sample logs the bytes actually used at start-up;
	  set this a little above that value.

config MODEL_ZEPHYR_REGION
	bool "Place the model and tensor arena in a Zephyr memory region"
	help
	  Copy the model from flash at start-up into the region named by
	  MODEL_ZEPHYR_REGION_NAME, and allocate the tensor arena there. Use it
	  when the default RAM is too small; the NPU must be able to reach the
	  region.

config MODEL_ZEPHYR_REGION_NAME
	string "Memory region name"
	depends on MODEL_ZEPHYR_REGION
	default "SRAM1"
	help
	  Name of a zephyr,memory-region devicetree node.

config INFERENCE_DROP_FRAMES
	bool "Drop frames decoded while the model is busy"
	help
	  By default the decoder waits for the model, so every frame of the
	  file is classified. Enable this for live sources, where waiting
	  would only add latency.

config INFERENCE_STACK_SIZE
	int "Inference thread stack size"
	default 4096

config INFERENCE_PRIORITY
	int "Inference thread priority"
	default 5

endmenu

source "Kconfig.zephyr"
```

## prj.conf
```kconfig
CONFIG_LOG=y

# main() mounts the filesystem and may write the test input before starting
# the pipeline, which the default main stack does not cover.
CONFIG_MAIN_STACK_SIZE=2048

CONFIG_MPIPE=y
CONFIG_MPIPE_STRUCTURE_MAX_FIELDS=3
CONFIG_MPIPE_BASE=y
CONFIG_MPIPE_BASE_CAPS_FILTER=y
CONFIG_MPIPE_BASE_APP_SINK=y
CONFIG_MPIPE_FS=y
CONFIG_MPIPE_IMG=y
CONFIG_MPIPE_PLAYER=y
# At the parser, we need simultaneously 1 input + 1 output + 1 partial (for next frame) buffers
CONFIG_MPIPE_NET_BUF_POOL_COUNT=3
CONFIG_MPIPE_IMG_JPEG_PARSER_MAX_FRAME_SIZE=153600

CONFIG_FILE_SYSTEM=y
CONFIG_FAT_FILESYSTEM_ELM=y
CONFIG_FS_FATFS_LFN=y
CONFIG_FS_FATFS_MAX_LFN=255
CONFIG_DISK_ACCESS=y
CONFIG_DISK_DRIVERS=y

CONFIG_ZBUS_PRIORITY_BOOST=n
CONFIG_ZBUS_LOG_LEVEL_ERR=y

# TensorFlow Lite Micro
CONFIG_CPP=y
CONFIG_STD_CPP17=y
CONFIG_TENSORFLOW_LITE_MICRO=y
```

## boards/mimxrt700_evk_mimxrt798s_cm33_cpu0.conf
```kconfig
CONFIG_DCACHE=n
# Decoder: 2 input + 1 output
CONFIG_VIDEO_BUFFER_POOL_NUM_MAX=3
# Each buffer is estimated at width * height * 2 bytes (NV12 needs two full
# planes for the JPEG decoder): 3 * 576 * 432 * 2 + alignment, in SRAM1
# (2 MiB) next to the model and tensor arena.
CONFIG_VIDEO_BUFFER_POOL_HEAP_SIZE=1545000
CONFIG_VIDEO_BUFFER_POOL_ZEPHYR_REGION=y
CONFIG_VIDEO_BUFFER_POOL_ZEPHYR_REGION_NAME="SRAM1"

CONFIG_MPIPE_VID=y
# The hardware decoder is used: keep the software decoder's pool minimal
CONFIG_MPIPE_IMG_JPEG_DECODER_MAX_OUT_FRAME_SIZE=4

# Neutron NPU: operators the compiler did not offload run on CMSIS-NN
CONFIG_GLIBCXX_LIBCPP=y
CONFIG_FPU=y
CONFIG_TENSORFLOW_LITE_MICRO_CMSIS_NN_KERNELS=y
CONFIG_TFLM_NXP_NEUTRON=y

# The model and the arena do not fit the 512 KiB default RAM. SRAM1 is within
# the 5.5 MiB the NPU can address.
CONFIG_MODEL_ZEPHYR_REGION=y
CONFIG_MODEL_ZEPHYR_REGION_NAME="SRAM1"
```

## boards/native_sim_64.conf
```kconfig
# Flash-backed FAT volume (disk-name "SD") for native_sim
CONFIG_FLASH_SIMULATOR=y
CONFIG_DISK_DRIVER_FLASH=y

CONFIG_UART_NATIVE_PTY_0_ON_STDINOUT=y
CONFIG_LOG_BACKEND_NATIVE_POSIX=y
CONFIG_SHELL_LOG_BACKEND=n

# Threads on native_sim run on host stacks, so this size is never used and
# only reserves memory.
CONFIG_MPIPE_PLAYER_WORKER_STACK_SIZE=64

# SW decoder output: 576x432 RGB565
CONFIG_MPIPE_IMG_JPEG_DECODER_MAX_OUT_FRAME_SIZE=497664

# No NPU: the model runs on TFLM reference kernels, with larger activations
# than the NPU-compiled graph
CONFIG_TENSOR_ARENA_SIZE=262144
```

## src/main.c
```c
/*
 * Copyright 2026 NXP
 *
 * SPDX-License-Identifier: Apache-2.0
 */

#include <errno.h>
#include <string.h>
#if defined(CONFIG_FAT_FILESYSTEM_ELM)
#include <ff.h>
#endif

#include <zephyr/drivers/video.h>
#include <zephyr/fs/fs.h>
#include <zephyr/kernel.h>
#include <zephyr/logging/log.h>

#include <zephyr/mpipe/mpipe.h>
#include <zephyr/mpipe/base/mpipe_app_sink.h>
#include <zephyr/mpipe/base/mpipe_caps_filter.h>
#include <zephyr/mpipe/fs/mpipe_file_src.h>
#include <zephyr/mpipe/img/mpipe_img_jpeg_decoder.h>
#include <zephyr/mpipe/img/mpipe_img_jpeg_parser.h>
#include <zephyr/mpipe/utils/mpipe_player.h>
#if DT_HAS_CHOSEN(zephyr_jpegdec)
#include <zephyr/mpipe/vid/mpipe_vid_transform.h>
#endif

#include "inference.h"
#include "preprocess.h"

LOG_MODULE_REGISTER(main, CONFIG_LOG_DEFAULT_LEVEL);

/* Element IDs (values are arbitrary; only uniqueness within the pipeline matters) */
enum {
	PIPE_ID,
	FILE_SRC_ID,
	JPEG_PARSER_ID,
	CAPS_FILTER_ID,
	JPEG_DEC_ID,
	APP_SINK_ID,
};

#define MNT_POINT   "/SD:"
#define MAX_CLASSES 32

#if defined(CONFIG_FAT_FILESYSTEM_ELM)
static FATFS fat_fs;
#endif

static struct fs_mount_t mp = {
	.type = FS_FATFS,
#if defined(CONFIG_FAT_FILESYSTEM_ELM)
	.fs_data = &fat_fs,
#endif
	.mnt_point = MNT_POINT,
};

static struct mpipe pipe;
static struct mpipe_file_src file_src;
static struct mpipe_img_jpeg_parser jpeg_parser;
static struct mpipe_caps_filter caps_filter;
#if DT_HAS_CHOSEN(zephyr_jpegdec)
static struct mpipe_vid_transform jpeg_dec;
#else
static struct mpipe_img_jpeg_decoder jpeg_dec;
#endif
static struct mpipe_app_sink app_sink;
static struct mpipe_player player;

static struct inference_input model_in;
static size_t num_classes;
static const char *labels[MAX_CLASSES];
static char labels_buf[sizeof(CONFIG_MODEL_LABELS)];

K_THREAD_STACK_DEFINE(inference_stack, CONFIG_INFERENCE_STACK_SIZE);
static struct k_thread inference_tid;

#if defined(EMBED_TEST_MJPEG)
static const uint8_t mjpeg[] = {
#include "mjpeg.inc"
};

/* Write the embedded test input unless the volume already holds an input file */
static int embed_test_file(void)
{
	struct fs_dirent ent;
	struct fs_file_t f;
	ssize_t w;
	int ret = fs_stat(CONFIG_FILE_INPUT_PATH, &ent);

	if (ret == 0) {
		return 0;
	}

	if (ret != -ENOENT) {
		LOG_ERR("fs_stat(%s) failed (%d)", CONFIG_FILE_INPUT_PATH, ret);
		return ret;
	}

	fs_file_t_init(&f);

	ret = fs_open(&f, CONFIG_FILE_INPUT_PATH, FS_O_CREATE | FS_O_WRITE);
	if (ret != 0) {
		LOG_ERR("fs_open(%s) failed (%d)", CONFIG_FILE_INPUT_PATH, ret);
		return ret;
	}

	w = fs_write(&f, mjpeg, sizeof(mjpeg));
	(void)fs_close(&f);

	if (w < 0 || (size_t)w != sizeof(mjpeg)) {
		LOG_ERR("fs_write failed (%d)", (int)w);
		return (w < 0) ? (int)w : -EIO;
	}

	LOG_INF("Wrote embedded test input to %s (%u bytes)", CONFIG_FILE_INPUT_PATH,
		(unsigned int)sizeof(mjpeg));

	return 0;
}
#endif

static int mount_sd(void)
{
	int ret = fs_mount(&mp);

	if (ret != 0) {
		LOG_ERR("fs_mount failed (%d)", ret);
		return ret;
	}

	LOG_INF("SD card mounted at %s", MNT_POINT);

#if defined(EMBED_TEST_MJPEG)
	return embed_test_file();
#else
	return 0;
#endif
}

/* Split CONFIG_MODEL_LABELS at the commas; missing labels print as "?" */
static void parse_labels(void)
{
	size_t n = 0;
	char *s = labels_buf;

	memcpy(labels_buf, CONFIG_MODEL_LABELS, sizeof(labels_buf));

	while (n < ARRAY_SIZE(labels)) {
		labels[n++] = s;
		s = strchr(s, ',');
		if (s == NULL) {
			break;
		}
		*s++ = '\0';
	}

	for (; n < ARRAY_SIZE(labels); n++) {
		labels[n] = "?";
	}
}

/* Format and size the pipeline negotiated for the frames reaching the sink */
static int sink_frame_format(struct preprocess_frame *frame)
{
	const struct mpipe_structure *caps = &app_sink.sink.sink_pad.caps;
	const struct mpipe_value *fmt = mpipe_structure_get_value(caps, MPIPE_CAPS_PIXEL_FORMAT);
	const struct mpipe_value *w = mpipe_structure_get_value(caps, MPIPE_CAPS_IMAGE_WIDTH);
	const struct mpipe_value *h = mpipe_structure_get_value(caps, MPIPE_CAPS_IMAGE_HEIGHT);

	if (fmt == NULL || w == NULL || h == NULL) {
		return -EINVAL;
	}

	frame->pixfmt = mpipe_value_get_uint(fmt);
	frame->width = (uint16_t)mpipe_value_get_uint(w);
	frame->height = (uint16_t)mpipe_value_get_uint(h);

	return 0;
}

/*
 * Handshake between the streaming thread, which fills the input tensor, and
 * the inference thread, which runs the model on it. The tensor is in use
 * while a frame is being classified: the next frame waits for it, or is
 * dropped with CONFIG_INFERENCE_DROP_FRAMES.
 */
static K_SEM_DEFINE(model_idle, 1, 1);
static K_SEM_DEFINE(frame_ready, 0, 1);
static uint32_t frame_num;
static uint32_t frame_pre_us;
static uint32_t frames_dropped;

/*
 * Runs on the streaming thread for every decoded frame. Converting the frame
 * here, rather than queueing it for the inference thread, returns the decoder's
 * buffer at once: holding it would starve decoders that own a single output
 * buffer.
 */
static void frame_cb(const struct net_buf *buf, void *user_data)
{
	ARG_UNUSED(user_data);

	struct preprocess_frame frame = {
		.data = buf->data,
		.size = mpipe_buffer_get_meta(buf)->bytes_used,
	};
	uint32_t start = k_cycle_get_32();
	int ret;

	if (k_sem_take(&model_idle,
		       IS_ENABLED(CONFIG_INFERENCE_DROP_FRAMES) ? K_NO_WAIT : K_FOREVER) != 0) {
		frames_dropped++;
		return;
	}

	ret = sink_frame_format(&frame);
	if (ret == 0) {
		ret = preprocess_run(&frame, &model_in);
	}

	if (ret != 0) {
		LOG_ERR("Frame %u: preprocessing failed (%d), format %c%c%c%c %ux%u", frame_num,
			ret, (char)frame.pixfmt, (char)(frame.pixfmt >> 8),
			(char)(frame.pixfmt >> 16), (char)(frame.pixfmt >> 24), frame.width,
			frame.height);
		frame_num++;
		k_sem_give(&model_idle);
		return;
	}

	frame_pre_us = (uint32_t)k_cyc_to_us_floor64(k_cycle_get_32() - start);
	k_sem_give(&frame_ready);
}

static void inference_thread(void *p1, void *p2, void *p3)
{
	ARG_UNUSED(p1);
	ARG_UNUSED(p2);
	ARG_UNUSED(p3);

	while (true) {
		float scores[MAX_CLASSES];
		uint32_t run_us;
		size_t best = 0;
		int ret;

		(void)k_sem_take(&frame_ready, K_FOREVER);

		ret = inference_run(scores, num_classes, &run_us);
		if (ret != 0) {
			LOG_ERR("Frame %u: inference failed (%d)", frame_num, ret);
		} else {
			for (size_t i = 1; i < num_classes; i++) {
				if (scores[i] > scores[best]) {
					best = i;
				}
			}

			LOG_INF("Frame %u: %s %u%% (preprocess %u us, inference %u us, "
				"%u dropped)",
				frame_num, labels[best],
				(unsigned int)(scores[best] * 100.0f + 0.5f), frame_pre_us, run_us,
				frames_dropped);
		}

		frame_num++;
		k_sem_give(&model_idle);
	}
}

static int setup_pipeline(void)
{
	int ret = mpipe_pipeline_init(&pipe, PIPE_ID);

	if (ret != 0) {
		return ret;
	}

	ret = mpipe_file_src_init(&file_src, FILE_SRC_ID);
	if (ret != 0) {
		return ret;
	}

	ret = mpipe_img_jpeg_parser_init(&jpeg_parser, JPEG_PARSER_ID);
	if (ret != 0) {
		return ret;
	}

	ret = mpipe_caps_filter_init(&caps_filter, CAPS_FILTER_ID);
	if (ret != 0) {
		return ret;
	}

#if DT_HAS_CHOSEN(zephyr_jpegdec)
	ret = mpipe_vid_transform_init(&jpeg_dec, JPEG_DEC_ID);
	if (ret != 0) {
		return ret;
	}

	ret = mpipe_object_set_properties((struct mpipe_object *)&jpeg_dec, MPIPE_PROP_VID_DEVICE,
					  DEVICE_DT_GET(DT_CHOSEN(zephyr_jpegdec)),
					  MPIPE_PROP_LIST_END);
	if (ret != 0) {
		return ret;
	}
#else
	ret = mpipe_img_jpeg_decoder_init(&jpeg_dec, JPEG_DEC_ID);
	if (ret != 0) {
		return ret;
	}
#endif

	ret = mpipe_app_sink_init(&app_sink, APP_SINK_ID);
	if (ret != 0) {
		return ret;
	}

	static const struct mpipe_app_sink_cb cb = {.fn = frame_cb};

	ret = mpipe_object_set_properties((struct mpipe_object *)&app_sink,
					  MPIPE_PROP_BASE_APP_SINK_CB, &cb, MPIPE_PROP_LIST_END);
	if (ret != 0) {
		return ret;
	}

	ret = mpipe_object_set_properties((struct mpipe_object *)&file_src, MPIPE_PROP_FS_SRC_PATH,
					  CONFIG_FILE_INPUT_PATH, MPIPE_PROP_LIST_END);
	if (ret != 0) {
		return ret;
	}

	struct mpipe_structure caps;

	ret = mpipe_structure_init_fields(
		&caps, MPIPE_MEDIA_VIDEO, MPIPE_CAPS_PIXEL_FORMAT, MPIPE_TYPE_UINT,
		VIDEO_PIX_FMT_JPEG, MPIPE_CAPS_IMAGE_WIDTH, MPIPE_TYPE_UINT,
		CONFIG_JPEG_IMAGE_WIDTH, MPIPE_CAPS_IMAGE_HEIGHT, MPIPE_TYPE_UINT,
		CONFIG_JPEG_IMAGE_HEIGHT, MPIPE_CAPS_END);
	if (ret != 0) {
		return ret;
	}

	ret = mpipe_object_set_properties((struct mpipe_object *)&caps_filter,
					  MPIPE_PROP_BASE_CAPS_FILTER_CAPS, &caps,
					  MPIPE_PROP_LIST_END);
	if (ret != 0) {
		return ret;
	}

	ret = mpipe_bin_add((struct mpipe_bin *)&pipe, (struct mpipe_element *)&file_src,
			    (struct mpipe_element *)&jpeg_parser,
			    (struct mpipe_element *)&caps_filter, (struct mpipe_element *)&jpeg_dec,
			    (struct mpipe_element *)&app_sink, NULL);
	if (ret != 0) {
		LOG_ERR("Failed to add elements (%d)", ret);
		return ret;
	}

	ret = mpipe_element_link(
		(struct mpipe_element *)&file_src, (struct mpipe_element *)&jpeg_parser,
		(struct mpipe_element *)&caps_filter, (struct mpipe_element *)&jpeg_dec,
		(struct mpipe_element *)&app_sink, NULL);
	if (ret != 0) {
		LOG_ERR("Failed to link elements (%d)", ret);
		return ret;
	}

	return 0;
}

int main(void)
{
	int ret = mount_sd();

	if (ret != 0) {
		return 0;
	}

	ret = inference_init(&model_in, &num_classes);
	if (ret != 0) {
		LOG_ERR("Model setup failed (%d)", ret);
		return 0;
	}

	if (num_classes > MAX_CLASSES) {
		LOG_WRN("Model has %u classes, only the first %u are scored",
			(unsigned int)num_classes, MAX_CLASSES);
		num_classes = MAX_CLASSES;
	}

	preprocess_init(&model_in);
	parse_labels();

	ret = setup_pipeline();
	if (ret != 0) {
		LOG_ERR("Pipeline setup failed (%d)", ret);
		return 0;
	}

	(void)k_thread_create(&inference_tid, inference_stack,
			      K_THREAD_STACK_SIZEOF(inference_stack), inference_thread, NULL, NULL,
			      NULL, CONFIG_INFERENCE_PRIORITY, 0, K_NO_WAIT);
	(void)k_thread_name_set(&inference_tid, "inference");

	ret = mpipe_player_init(&player, &pipe);
	if (ret != 0) {
		LOG_ERR("Failed to init player (%d)", ret);
		return 0;
	}

	(void)mpipe_player_play(&player);
	(void)mpipe_player_wait_quit(&player);
	(void)mpipe_player_deinit(&player);

	ret = fs_unmount(&mp);
	if (ret != 0) {
		LOG_ERR("fs_unmount failed (%d)", ret);
	}

	LOG_INF("Done.");

	return 0;
}
```

## src/inference.cpp
```c
/*
 * Copyright 2026 NXP
 *
 * SPDX-License-Identifier: Apache-2.0
 */

#include <errno.h>
#include <string.h>

#include <zephyr/kernel.h>
#include <zephyr/linker/section_tags.h>
#include <zephyr/logging/log.h>

#include <tensorflow/lite/micro/micro_interpreter.h>
#include <tensorflow/lite/micro/micro_mutable_op_resolver.h>
#include <tensorflow/lite/schema/schema_generated.h>
#if defined(CONFIG_TFLM_NXP_NEUTRON)
#include <tensorflow/lite/micro/kernels/neutron/neutron.h>
#endif

#include "inference.h"

LOG_MODULE_REGISTER(inference, CONFIG_LOG_DEFAULT_LEVEL);

/*
 * The model is not used from flash: the NPU reads the microcode and weights
 * embedded in it straight from memory, and it reaches the internal SRAM only.
 * The NPU also writes the tensors itself, behind the CPU data cache.
 */
#if defined(CONFIG_MODEL_ZEPHYR_REGION)
#define MODEL_SECTION Z_GENERIC_SECTION(CONFIG_MODEL_ZEPHYR_REGION_NAME)

/* A memory region is not loaded at boot: inference_init() copies the model in */
static const uint8_t model_image[] = {
#include "model.inc"
};
alignas(16) static uint8_t model_data[sizeof(model_image)] MODEL_SECTION;
alignas(16) static uint8_t tensor_arena[CONFIG_TENSOR_ARENA_SIZE] MODEL_SECTION;
#else
alignas(16) static uint8_t model_data[] = {
#include "model.inc"
};
alignas(16) static uint8_t tensor_arena[CONFIG_TENSOR_ARENA_SIZE] __nocache;
#endif

static tflite::MicroInterpreter *interpreter;

static int register_ops(tflite::MicroMutableOpResolver<8> &resolver)
{
	/*
	 * NeutronGraph runs what the Neutron compiler offloaded. The builtins
	 * cover the layers it left on the CPU and the uncompiled model used
	 * without NPU.
	 */
#if defined(CONFIG_TFLM_NXP_NEUTRON)
	if (resolver.AddCustom(tflite::GetString_NEUTRON_GRAPH(),
			       tflite::Register_NEUTRON_GRAPH()) != kTfLiteOk) {
		return -EINVAL;
	}
#endif
	if (resolver.AddAveragePool2D() != kTfLiteOk || resolver.AddConv2D() != kTfLiteOk ||
	    resolver.AddDepthwiseConv2D() != kTfLiteOk ||
	    resolver.AddFullyConnected() != kTfLiteOk || resolver.AddReshape() != kTfLiteOk ||
	    resolver.AddSoftmax() != kTfLiteOk) {
		return -EINVAL;
	}

	return 0;
}

int inference_init(struct inference_input *input, size_t *num_classes)
{
	static tflite::MicroMutableOpResolver<8> resolver;
	int ret;

	__ASSERT_NO_MSG(input != NULL);
	__ASSERT_NO_MSG(num_classes != NULL);

#if defined(CONFIG_MODEL_ZEPHYR_REGION)
	memcpy(model_data, model_image, sizeof(model_data));
#endif

	const tflite::Model *model = tflite::GetModel(model_data);

	if (model->version() != TFLITE_SCHEMA_VERSION) {
		LOG_ERR("Model schema %u, expected %d", (unsigned int)model->version(),
			TFLITE_SCHEMA_VERSION);
		return -EINVAL;
	}

	ret = register_ops(resolver);
	if (ret != 0) {
		LOG_ERR("Failed to register operators (%d)", ret);
		return ret;
	}

	static tflite::MicroInterpreter static_interpreter(model, resolver, tensor_arena,
							   sizeof(tensor_arena));

	if (static_interpreter.AllocateTensors() != kTfLiteOk) {
		LOG_ERR("Tensor allocation failed, raise CONFIG_TENSOR_ARENA_SIZE");
		return -ENOMEM;
	}

	TfLiteTensor *in = static_interpreter.input(0);
	TfLiteTensor *out = static_interpreter.output(0);

	if (in->type != kTfLiteInt8 || in->dims->size != 4 || in->dims->data[0] != 1 ||
	    (in->dims->data[3] != 1 && in->dims->data[3] != 3)) {
		LOG_ERR("Input must be int8 [1, H, W, 1 or 3]");
		return -EINVAL;
	}

	if (out->type != kTfLiteInt8 || out->dims->size != 2) {
		LOG_ERR("Output must be int8 [1, classes]");
		return -EINVAL;
	}

	input->data = in->data.int8;
	input->height = (uint16_t)in->dims->data[1];
	input->width = (uint16_t)in->dims->data[2];
	input->channels = (uint16_t)in->dims->data[3];
	input->scale = in->params.scale;
	input->zero_point = in->params.zero_point;
	*num_classes = (size_t)out->dims->data[1];

	interpreter = &static_interpreter;

	LOG_INF("Model %u bytes, input %ux%ux%u, %u classes, arena %u of %u bytes used",
		(unsigned int)sizeof(model_data), input->width, input->height, input->channels,
		(unsigned int)*num_classes, (unsigned int)static_interpreter.arena_used_bytes(),
		(unsigned int)sizeof(tensor_arena));

	return 0;
}

int inference_run(float *scores, size_t num_scores, uint32_t *usec)
{
	__ASSERT_NO_MSG(interpreter != NULL);
	__ASSERT_NO_MSG(scores != NULL);
	__ASSERT_NO_MSG(usec != NULL);

	uint32_t start = k_cycle_get_32();

	if (interpreter->Invoke() != kTfLiteOk) {
		return -EIO;
	}

	*usec = (uint32_t)k_cyc_to_us_floor64(k_cycle_get_32() - start);

	TfLiteTensor *out = interpreter->output(0);
	size_t n = MIN(num_scores, (size_t)out->dims->data[1]);

	for (size_t i = 0; i < n; i++) {
		scores[i] = out->params.scale * (float)(out->data.int8[i] - out->params.zero_point);
	}

	return 0;
}
```

## src/inference.h
```c
/*
 * Copyright 2026 NXP
 *
 * SPDX-License-Identifier: Apache-2.0
 */

#ifndef JPEG_NPU_INFERENCE_H_
#define JPEG_NPU_INFERENCE_H_

#include <stddef.h>
#include <stdint.h>

#ifdef __cplusplus
extern "C" {
#endif

/** Model input tensor: an int8 image in NHWC order, filled by the caller */
struct inference_input {
	/** Tensor data, width * height * channels bytes */
	int8_t *data;
	/** Image width in pixels */
	uint16_t width;
	/** Image height in pixels */
	uint16_t height;
	/** 1 (grey) or 3 (RGB) */
	uint16_t channels;
	/** Quantization: real = scale * (q - zero_point) */
	float scale;
	/** Quantization zero point */
	int32_t zero_point;
};

/**
 * @brief Load the model and allocate its tensors
 *
 * @param[out] input Description of the input tensor to fill before each run
 * @param[out] num_classes Number of model outputs
 *
 * @retval 0 Success
 * @retval -EINVAL Unsupported model (schema, input type or shape)
 * @retval -ENOMEM Tensor arena too small
 */
int inference_init(struct inference_input *input, size_t *num_classes);

/**
 * @brief Run the model on the current input tensor
 *
 * @param[out] scores Dequantized outputs, one per class
 * @param num_scores Room in @p scores
 * @param[out] usec Duration of the model invocation in microseconds
 *
 * @retval 0 Success
 * @retval -EIO The invocation failed
 */
int inference_run(float *scores, size_t num_scores, uint32_t *usec);

#ifdef __cplusplus
}
#endif

#endif /* JPEG_NPU_INFERENCE_H_ */
```

## src/preprocess.c
```c
/*
 * Copyright 2026 NXP
 *
 * SPDX-License-Identifier: Apache-2.0
 */

#include <errno.h>
#include <math.h>

#include <zephyr/drivers/video.h>
#include <zephyr/sys/util.h>

#include "preprocess.h"

/* Samples per axis averaged into one output pixel, bounding the cost on large frames */
#define AREA_SAMPLES 4U

/* Quantized value of each 8-bit pixel level, for the current model input */
static int8_t quant_lut[256];

void preprocess_init(const struct inference_input *input)
{
	__ASSERT_NO_MSG(input != NULL);

	for (int i = 0; i < 256; i++) {
		int32_t q =
			(int32_t)lroundf(((float)i / 255.0f) / input->scale) + input->zero_point;

		quant_lut[i] = (int8_t)CLAMP(q, INT8_MIN, INT8_MAX);
	}
}

static size_t frame_bytes(uint32_t pixfmt, size_t pixels)
{
	switch (pixfmt) {
	case VIDEO_PIX_FMT_NV12:
		return pixels + pixels / 2U;
	case VIDEO_PIX_FMT_YUYV:
	case VIDEO_PIX_FMT_RGB565:
	case VIDEO_PIX_FMT_RGB565X:
		return pixels * 2U;
	case VIDEO_PIX_FMT_YUV24:
	case VIDEO_PIX_FMT_BGR24:
		return pixels * 3U;
	case VIDEO_PIX_FMT_GREY:
		return pixels;
	default:
		return 0;
	}
}

static void yuv_to_rgb(uint8_t y, uint8_t u8, uint8_t v8, uint8_t rgb[3])
{
	int32_t u = (int32_t)u8 - 128;
	int32_t v = (int32_t)v8 - 128;

	rgb[0] = (uint8_t)CLAMP((int32_t)y + 1402 * v / 1000, 0, 255);
	rgb[1] = (uint8_t)CLAMP((int32_t)y - (344 * u + 714 * v) / 1000, 0, 255);
	rgb[2] = (uint8_t)CLAMP((int32_t)y + 1772 * u / 1000, 0, 255);
}

/* RGB value of pixel (x, y); the format was checked by the caller */
static void read_pixel(const struct preprocess_frame *f, uint32_t x, uint32_t y, uint8_t rgb[3])
{
	const uint8_t *d = f->data;
	size_t idx = (size_t)y * f->width + x;
	uint16_t px;

	switch (f->pixfmt) {
	case VIDEO_PIX_FMT_NV12: {
		/* The interleaved UV plane follows the Y plane, one pair per 2x2 block */
		const uint8_t *uv =
			d + (size_t)f->width * f->height + (size_t)(y / 2U) * f->width + (x & ~1U);

		yuv_to_rgb(d[idx], uv[0], uv[1], rgb);
		break;
	}
	case VIDEO_PIX_FMT_YUYV: {
		/* Y0 U Y1 V: one U/V pair per 2 pixels */
		const uint8_t *pair = d + ((size_t)y * f->width + (x & ~1U)) * 2U;

		yuv_to_rgb(pair[(x & 1U) * 2U], pair[1], pair[3], rgb);
		break;
	}
	case VIDEO_PIX_FMT_YUV24:
		yuv_to_rgb(d[idx * 3U], d[idx * 3U + 1U], d[idx * 3U + 2U], rgb);
		break;
	case VIDEO_PIX_FMT_BGR24:
		rgb[0] = d[idx * 3U + 2U];
		rgb[1] = d[idx * 3U + 1U];
		rgb[2] = d[idx * 3U];
		break;
	case VIDEO_PIX_FMT_GREY:
		rgb[0] = d[idx];
		rgb[1] = d[idx];
		rgb[2] = d[idx];
		break;
	case VIDEO_PIX_FMT_RGB565:
	case VIDEO_PIX_FMT_RGB565X:
		px = (f->pixfmt == VIDEO_PIX_FMT_RGB565)
			     ? (uint16_t)(d[idx * 2U] | (d[idx * 2U + 1U] << 8))
			     : (uint16_t)((d[idx * 2U] << 8) | d[idx * 2U + 1U]);
		/* Expand to 8 bits, replicating the high bits into the low ones */
		rgb[0] = (uint8_t)(((px >> 8) & 0xF8U) | ((px >> 13) & 0x07U));
		rgb[1] = (uint8_t)(((px >> 3) & 0xFCU) | ((px >> 9) & 0x03U));
		rgb[2] = (uint8_t)(((px << 3) & 0xF8U) | ((px >> 2) & 0x07U));
		break;
	default:
		break;
	}
}

int preprocess_run(const struct preprocess_frame *frame, const struct inference_input *input)
{
	__ASSERT_NO_MSG(frame != NULL);
	__ASSERT_NO_MSG(input != NULL);

	size_t need = frame_bytes(frame->pixfmt, (size_t)frame->width * frame->height);

	if (need == 0) {
		return -ENOTSUP;
	}

	if (frame->size < need || frame->width == 0 || frame->height == 0) {
		return -EINVAL;
	}

	int8_t *out = input->data;

	for (uint32_t oy = 0; oy < input->height; oy++) {
		uint32_t y0 = (oy * frame->height) / input->height;
		uint32_t y1 = MAX(((oy + 1U) * frame->height) / input->height, y0 + 1U);
		uint32_t ystep = MAX((y1 - y0) / AREA_SAMPLES, 1U);

		for (uint32_t ox = 0; ox < input->width; ox++) {
			uint32_t x0 = (ox * frame->width) / input->width;
			uint32_t x1 = MAX(((ox + 1U) * frame->width) / input->width, x0 + 1U);
			uint32_t xstep = MAX((x1 - x0) / AREA_SAMPLES, 1U);
			uint32_t sum[3] = {0};
			uint32_t n = 0;

			/*
			 * Average the source area an output pixel covers: a single
			 * sample per pixel aliases fine detail into noise at the
			 * usual 4x to 8x reduction, and the model's score with it.
			 */
			for (uint32_t sy = y0; sy < y1; sy += ystep) {
				for (uint32_t sx = x0; sx < x1; sx += xstep) {
					uint8_t rgb[3];

					read_pixel(frame, sx, sy, rgb);
					sum[0] += rgb[0];
					sum[1] += rgb[1];
					sum[2] += rgb[2];
					n++;
				}
			}

			uint8_t r = (uint8_t)((sum[0] + n / 2U) / n);
			uint8_t g = (uint8_t)((sum[1] + n / 2U) / n);
			uint8_t b = (uint8_t)((sum[2] + n / 2U) / n);

			if (input->channels == 1U) {
				/* BT.601 luma */
				*out++ = quant_lut[(299U * r + 587U * g + 114U * b) / 1000U];
			} else {
				*out++ = quant_lut[r];
				*out++ = quant_lut[g];
				*out++ = quant_lut[b];
			}
		}
	}

	return 0;
}
```

## src/preprocess.h
```c
/*
 * Copyright 2026 NXP
 *
 * SPDX-License-Identifier: Apache-2.0
 */

#ifndef JPEG_NPU_PREPROCESS_H_
#define JPEG_NPU_PREPROCESS_H_

#include <stddef.h>
#include <stdint.h>

#include "inference.h"

/** A decoded frame as it leaves the pipeline */
struct preprocess_frame {
	/** Pixel data, planes back to back with no row padding */
	const uint8_t *data;
	/** Valid bytes in @p data */
	size_t size;
	/** VIDEO_PIX_FMT_* code */
	uint32_t pixfmt;
	/** Frame width in pixels */
	uint16_t width;
	/** Frame height in pixels */
	uint16_t height;
};

/**
 * @brief Prepare the quantization table for a model input
 *
 * The model is assumed to take pixel values normalized to [0, 1].
 *
 * @param input Model input tensor description
 */
void preprocess_init(const struct inference_input *input);

/**
 * @brief Scale a decoded frame to the model input and quantize it
 *
 * Each output pixel averages up to 4x4 samples of the source area it covers.
 * YUV is converted to RGB with the BT.601 full-range
 * (JFIF) equations. Supported formats: NV12, YUYV, YUV24, GREY, BGR24,
 * RGB565 and RGB565X.
 *
 * @param frame The decoded frame
 * @param input Model input tensor to fill
 *
 * @retval 0 Success
 * @retval -ENOTSUP Unsupported pixel format
 * @retval -EINVAL Frame smaller than its format and size require
 */
int preprocess_run(const struct preprocess_frame *frame, const struct inference_input *input);

#endif /* JPEG_NPU_PREPROCESS_H_ */
```
